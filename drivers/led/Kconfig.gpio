## drivers/led/Kconfig.gpio
```kconfig
# Copyright (c) 2019 Nordic Semiconductor ASA
# SPDX-License-Identifier: Apache-2.0

config LED_GPIO
	bool "GPIO LED driver"
	depends on GPIO
	help
	  This option enables support for the LEDs connected to GPIO
	  outputs. To be useful the particular board must have LEDs
	  and they must be connected to the GPIO lines.

if LED_GPIO

module = LEDS_GPIO
module-str = Leds GPIO
source "${ZEPHYR_BASE}/subsys/logging/Kconfig.template.log_config"

endif # LED_GPIO
```

## dts/bindings/gpio/gpio-leds.yaml
```yaml
# Copyright (c) 2018, Linaro Limited
# SPDX-License-Identifier: Apache-2.0

title: GPIO LEDs

description: GPIO LEDs parent node

compatible: "gpio-leds"

properties:
    gpios:
        type: phandle-array
        required: true
    label:
        required: true
        type: string
        description: LED GPIO array 

child-binding:
    title: GPIO LED node
    description: GPIO LED child node
    properties:
       gpios:
          type: phandle-array
          required: false
       label:
          required: false
          type: string
          description: Human readable string describing the device (used by Zephyr for API name)
```
